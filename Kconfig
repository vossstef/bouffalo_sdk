## components/crypto/Kconfig
```kconfig
#
# Crypto components
#

menu "Crypto"

config MBEDTLS
    bool "mbedTLS"
    default n
    help
      Build the mbedTLS cryptography library.

if MBEDTLS

config MBEDTLS_V2
    bool "Use mbedTLS v2"
    default n
    help
      Link against the prebuilt mbedTLS v2 library instead of v3.

config MBEDTLS_CFG_FILE
    string "mbedTLS configuration file"
    default "config-tls-generic.h"
    help
      Name of the mbedTLS configuration header used by the build.

config MBEDTLS_DEBUG
    bool "mbedTLS debug output"
    default n
    help
      Enable mbedTLS debug logging output.

config MBEDTLS_DEBUG_LEVEL
    int "mbedTLS debug level"
    default 0
    depends on MBEDTLS_DEBUG
    help
      mbedTLS debug threshold: 0 off, 1 error, 2 state, 3 io, 4 verbose.

config MBEDTLS_DEBUG_STRIP_NEWLINE
    bool "Strip newlines from mbedTLS debug output"
    default n
    depends on MBEDTLS_DEBUG
    help
      Remove trailing newlines from mbedTLS debug messages.

config MBEDTLS_DEBUG_EXTRACT_BASENAME_AT_RUNTIME
    bool "Extract mbedTLS debug basename at runtime"
    default n
    depends on MBEDTLS_DEBUG
    help
      Strip path prefixes from mbedTLS source names at runtime instead of
      at compile time.

config MBEDTLS_SELF_TEST
    bool "mbedTLS self tests"
    default n
    help
      Build the mbedTLS self test entry points.

menu "mbedTLS hardware acceleration"

config MBEDTLS_AES_USE_HW
    bool "AES hardware acceleration"
    default n
    help
      Use the chip AES engine for mbedTLS AES operations.

config MBEDTLS_SHA1_USE_HW
    bool "SHA1 hardware acceleration"
    default n
    help
      Use the chip hash engine for mbedTLS SHA1 operations.

config MBEDTLS_SHA256_USE_HW
    bool "SHA256 hardware acceleration"
    default n
    help
      Use the chip hash engine for mbedTLS SHA256 operations.

config MBEDTLS_SHA512_USE_HW
    bool "SHA512 hardware acceleration"
    default n
    help
      Use the chip hash engine for mbedTLS SHA512 operations.

config MBEDTLS_ECC_USE_HW
    bool "ECC hardware acceleration"
    default n
    help
      Use the chip PKA engine for mbedTLS elliptic curve operations.

config MBEDTLS_BIGNUM_USE_HW
    bool "Bignum hardware acceleration"
    default n
    help
      Use the chip PKA engine for mbedTLS bignum operations.

endmenu

endif # CONFIG_MBEDTLS

endmenu
```

## components/fota/Kconfig
```kconfig
#
# FOTA components
#

menu "Firmware Update"

config FOTA
    bool "FOTA"
    default n
    help
      Build the firmware over-the-air update component.

config FOTA_NO_SHELL
    bool "Disable FOTA shell commands"
    default n
    depends on FOTA
    help
      Build FOTA without the shell command frontend.

config OTA_VERSION_CHECK
    bool "OTA version check"
    default n
    depends on FOTA
    help
      Compare the OTA image version against the running firmware before
      applying an update.

endmenu
```

## components/iperf/Kconfig
```kconfig
#
# Kconfig for compact Classic iPerf2
#

menu "iPerf"

config IPERF
    bool "Enable iPerf throughput test component"
    default n
    depends on FREERTOS && LWIP
    help
      Enable the compact IPv4 throughput test component with TCP and UDP
      client/server support through lwIP Socket and Raw backends.

      This component implements the Classic iPerf2 protocol and does not
      support iPerf3. FreeRTOS and lwIP must also be enabled by the application.
endmenu
```

## components/mm/Kconfig
```kconfig
#
# Memory management components
#

menu "Memory Management"

config MEM_TLSF_EN
    bool "TLSF allocator"
    default y
    help
      Enable the TLSF dynamic memory allocator.

config MEM_HEAP5_EN
    bool "Heap5 allocator"
    default n
    help
      Enable the FreeRTOS heap5 allocator as an additional memory region.

config TLSF
    bool "TLSF compatibility flag"
    default y
    help
      Legacy switch kept for compatibility with older configurations.

endmenu
```

## components/multimedia/Kconfig
```kconfig
#
# Multimedia components
#

menu "Multimedia"

config MULTIMEDIA
    bool "Multimedia framework"
    default n
    help
      Build the multimedia framework and its codec backends.

if MULTIMEDIA

config AACDEC
    bool "AAC decoder"
    default n
    help
      Build the AAC audio decoder.

config AMRNB
    bool "AMR-NB codec"
    default n
    help
      Build the AMR narrowband codec.

config AMRWB
    bool "AMR-WB codec"
    default n
    help
      Build the AMR wideband codec.

config PVMP3DEC
    bool "MP3 decoder"
    default n
    help
      Build the MP3 audio decoder.

config OPUS
    bool "Opus codec"
    default n
    help
      Build the Opus audio codec.

config SPEEX
    bool "Speex codec"
    default n
    help
      Build the Speex audio codec.

config SPEEXDSP
    bool "SpeexDSP"
    default n
    help
      Build the Speex DSP library.

config VORBIS
    bool "Vorbis codec"
    default n
    help
      Build the Vorbis audio decoder.

config OGG
    bool "Ogg container"
    default n
    help
      Build the Ogg container demuxer.

config SONIC
    bool "Sonic audio resampler"
    default n
    help
      Build the Sonic speed/pitch audio resampler.

config MINIALSA
    bool "Mini ALSA"
    default n
    help
      Build the mini ALSA userspace library.

config LIBFVAD
    bool "libfvad voice activity detection"
    default n
    help
      Build the libfvad voice activity detector.

config USERVICE
    bool "UService audio service"
    default n
    help
      Build the UService based audio service.

config AUIDIO_FLOWCTRL_BRIDGE
    bool "Audio flow-control bridge"
    default n
    help
      Build the audio flow-control bridge component.

config BL616_IMPLS
    bool "BL616 audio implementations"
    default n
    help
      Build BL616 specific multimedia implementations.

config DRV_SND_BL616
    bool "BL616 sound driver"
    default n
    help
      Build the BL616 sound device driver.

config SMART_AUDIO_BL616
    bool "BL616 smart audio"
    default n
    help
      Build the BL616 smart audio solution.

config AV
    bool "Audio/video framework"
    default n
    help
      Build the audio/video framework.

config XCODEC
    bool "X codec"
    default n
    help
      Build the X codec framework.

config XPORT
    bool "X port"
    default n
    help
      Build the X multimedia port layer.

config XUTILS
    bool "X utils"
    default n
    help
      Build the X multimedia utility library.

config XRECORD
    bool "X record"
    default n
    help
      Build the X audio recording component.

config XWEBSOCKET
    bool "X WebSocket"
    default n
    help
      Build the X multimedia WebSocket component.

config CODEC_ENABLE_HFP
    bool "Codec HFP mode"
    default n
    help
      Build codec support for the hands-free profile.

config CODEC_USE_I2S
    bool "Codec I2S interface"
    default n
    help
      Route the codec through the I2S interface.

config CODEC_USE_I2S_RX
    bool "Codec I2S receive"
    default n
    depends on CODEC_USE_I2S
    help
      Enable I2S receive direction for the codec.

config CODEC_USE_I2S_TX
    bool "Codec I2S transmit"
    default n
    depends on CODEC_USE_I2S
    help
      Enable I2S transmit direction for the codec.

config CODEC_USE_ES8388
    bool "ES8388 codec"
    default n
    help
      Use the ES8388 external codec in the multimedia port.

config MSP_USE_CODEC_ONLY
    bool "MSP codec only mode"
    default n
    help
      Build the multimedia service pipeline with codec support only.

config MSP_USE_STATIC_RAM
    bool "MSP static RAM"
    default n
    help
      Allocate multimedia service buffers from static RAM.

config XCODEC_OUTPUT_CACHE
    bool "X codec output cache"
    default n
    help
      Cache decoded audio output in the X codec pipeline.

endif # CONFIG_MULTIMEDIA

endmenu
```

## components/net/Kconfig
```kconfig
#
# Network components
#

menu "Network"

config LWIP
    bool "lwIP"
    default n
    help
      Build the lwIP TCP/IP stack.

if LWIP

config IPV6
    bool "IPv6"
    default n
    help
      Enable IPv6 support in the lwIP stack.

config DHCPD
    bool "DHCP server"
    default n
    help
      Build the lwIP DHCP server application.

config MDNS
    bool "mDNS responder"
    default n
    help
      Build the lwIP mDNS responder application.

config PING
    bool "Ping application"
    default n
    help
      Build the lwIP ping CLI application.

endif # CONFIG_LWIP

config NETBUS
    bool "Netbus"
    default n
    help
      Build the Netbus host/device communication framework.

if NETBUS

config NETIFD_NANO
    bool "netifd nano"
    default n
    help
      Build the nano network interface daemon for Netbus devices.

config DHCP_IN_EMB
    bool "Embedded DHCP client"
    default n
    help
      Enable the embedded DHCP client used by host router devices.

config CPU_E907
    bool "E907 CPU target"
    default n
    help
      Build Netbus device manager for the E907 CPU core.

config ATMODULE
    bool "AT module"
    default n
    help
      Build the AT command module.

config SPISYNC
    bool "AT module SPI sync transport"
    default n
    help
      Enable the SPI synchronous transport for the AT module.

config NXSPI_NET
    bool "NX SPI network transport"
    default n
    help
      Enable the NX SPI network transport for Netbus devices.

endif # CONFIG_NETBUS

config NETHUB
    bool "Nethub"
    default n
    help
      Build the Nethub networking hub component.

if NETHUB

choice
    prompt "Nethub host profile"
    default NETHUB_PROFILE_SDIO
    help
      Physical transport used to connect the Nethub host.

config NETHUB_PROFILE_SDIO
    bool "SDIO"
    help
      Connect the Nethub host over SDIO.

config NETHUB_PROFILE_USB
    bool "USB"
    help
      Connect the Nethub host over USB.

config NETHUB_PROFILE_SPI
    bool "SPI"
    help
      Connect the Nethub host over SPI.

endchoice

config NETHUB_PROFILE_DUAL
    bool "Dual profile"
    default n
    help
      Build both SDIO and USB Nethub host profiles.

config NETHUB_CTRLCHANNEL_USE_ATMODULE
    bool "Use AT module control channel"
    default n
    help
      Route Nethub control messages through the AT module.

config NETHUB_LOWPOWER_ENABLE
    bool "Nethub low power"
    default n
    help
      Enable low-power handling in the Nethub transport.

endif # CONFIG_NETHUB

config HTTP
    bool "HTTP"
    default n
    help
      Build the HTTP protocol library.

if HTTP

config HTTP_CLIENT
    bool "HTTP client"
    default y
    help
      Build the HTTP client implementation.

config HTTP_SERVER
    bool "HTTP server"
    default n
    help
      Build the HTTP server implementation.

config HTTP_PARSER_STRICT
    bool "Strict HTTP parser"
    default n
    help
      Enable strict RFC compliance checks in the HTTP parser.

config WEBSOCKET
    bool "WebSocket"
    default n
    help
      Build the WebSocket upgrade and framing support.

endif # CONFIG_HTTP

config MQTT
    bool "MQTT"
    default n
    help
      Build the MQTT client library.

config RTSP
    bool "RTSP"
    default n
    help
      Build the RTSP client library.

config LIBPEER
    bool "libpeer"
    default n
    help
      Build the peer-to-peer networking library.

config SRTP
    bool "SRTP"
    default n
    help
      Build the Secure RTP library.

source "$BL_SDK_BASE/components/net/netbus/atmodule/Kconfig"

endmenu
```
