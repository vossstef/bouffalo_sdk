/*
 * CONFIG_FLASH_XIP_ADDRESS
 * CONFIG_FLASH_XIP_LENGTH
 * CONFIG_WRAM_ADDRESS
 * CONFIG_WRAM_LENGTH
 * CONFIG_RAM_ADDRESS
 * CONFIG_RAM_LENGTH
 * CONFIG_PSRAM_ADDRESS
 * CONFIG_PSRAM_LENGTH
 */

/* 4M */
#define CONFIG_FLASH_XIP_ADDRESS 0xA0000000
#ifndef CONFIG_FLASH_XIP_LENGTH
#define CONFIG_FLASH_XIP_LENGTH 4096 * 1024
#endif

/* 4M */
#define CONFIG_PSRAM_ADDRESS 0xA8000000
#ifndef CONFIG_PSRAM_LENGTH
#define CONFIG_PSRAM_LENGTH 4096 * 1024
#endif

__EM_SIZE = DEFINED(btble_controller_init) ? 32K : 0K;

/* 32K for ZigBee/Thread (no WiFi) */
#define CONFIG_WRAM_ADDRESS 0x23038000 - 32K - __EM_SIZE
#define CONFIG_WRAM_LENGTH 32K

/* 320K + remain wram */
#define CONFIG_RAM_ADDRESS 0x62FC0000
#define CONFIG_RAM_LENGTH (320K + 160K - CONFIG_WRAM_LENGTH - __EM_SIZE)

#define RAM_HOLE 0x400
#define RAM_ADDRESS CONFIG_RAM_ADDRESS + RAM_HOLE
#define RAM_LENGTH CONFIG_RAM_LENGTH - RAM_HOLE

#define GROUP_START(name) __##name##_start__ = ABSOLUTE(ORIGIN(name)); . = ABSOLUTE(ORIGIN(name));
#define GROUP_END(name) __##name##_end__ = ABSOLUTE(.);

#define SECTION_CODE_PROLOGUE(name, attr, n) __##name##_start__ = ABSOLUTE(ADDR(name)); __##name##_end__ = ABSOLUTE(ADDR(name) + SIZEOF(name)); __##name##_load__ = ABSOLUTE(LOADADDR(name)); name attr:
#define SECTION_DATA_PROLOGUE(name, attr, n) __##name##_start__ = ABSOLUTE(ADDR(name)); __##name##_end__ = ABSOLUTE(ADDR(name) + SIZEOF(name)); __##name##_load__ = ABSOLUTE(LOADADDR(name)); name attr:
#define SECTION_BSS_PROLOGUE(name, attr, n) __##name##_start__ = ABSOLUTE(ADDR(name)); __##name##_end__ = ABSOLUTE(ADDR(name) + SIZEOF(name)); name attr:

#ifdef CONFIG_LPAPP
__LPFW_SIZE = 30K;
/* Link stage feature control */
PROVIDE( __macsw_conf_bl_wifi_ps_enable = 1 );
PROVIDE( __macsw_conf_plat_dma_enable = 0 );
#else
/* Link stage feature control */
PROVIDE( __macsw_conf_bl_wifi_ps_enable = 0 );
PROVIDE( __macsw_conf_plat_dma_enable = 1 );
#endif
PROVIDE(__LD_CONFIG_EM_SEL = __EM_SIZE);


OUTPUT_ARCH( "riscv" )
ENTRY(__start)

MEMORY
{
#if CONFIG_FLASH_XIP_ADDRESS
    fw_header  (rx)   : ORIGIN = CONFIG_FLASH_XIP_ADDRESS - 0x1000, LENGTH = 4K
    rom_header (rx)   : ORIGIN = CONFIG_FLASH_XIP_ADDRESS,          LENGTH = 6K
    rom (rx)          : ORIGIN = CONFIG_FLASH_XIP_ADDRESS + 0x1800, LENGTH = CONFIG_FLASH_XIP_LENGTH

    ram_nocache (!rx) : ORIGIN = (RAM_ADDRESS) & 0x2FFFFFFF,        LENGTH = RAM_LENGTH
    ram  (!rx)        : ORIGIN = RAM_ADDRESS,                       LENGTH = RAM_LENGTH
#else
    fw_header  (rx)   : ORIGIN = RAM_ADDRESS - (256+16),            LENGTH = 256+16
    rom_header (rx)   : ORIGIN = RAM_ADDRESS,                       LENGTH = 4K

    ram_nocache (!rx) : ORIGIN = (RAM_ADDRESS + 4K) & 0x2FFFFFFF,   LENGTH = RAM_LENGTH - 4K
    ram  (!rx)        : ORIGIN = RAM_ADDRESS + 4K,                  LENGTH = CONFIG_RAM_LENGTH
#endif

    ram_psram  (wxa)  : ORIGIN = CONFIG_PSRAM_ADDRESS,              LENGTH = CONFIG_PSRAM_LENGTH
    ram_wifi  (wxa)   : ORIGIN = CONFIG_WRAM_ADDRESS,               LENGTH = CONFIG_WRAM_LENGTH
    hbn_memory (rx)   : ORIGIN = 0x20010000,                        LENGTH = 512
}

#if !CONFIG_FLASH_XIP_ADDRESS
    REGION_ALIAS("rom", ram);
#endif

SECTIONS
{
    .fw_header :
    {
        KEEP(*(.fw_header))
#if !CONFIG_FLASH_XIP_ADDRESS
        LONG(CONFIG_RAM_ADDRESS)
        LONG(0x48474553)
#endif
    } > fw_header

    GROUP_START(rom_header)
    .init ORIGIN(rom_header):
    {
        KEEP (*(SORT_NONE(.init)))
        KEEP (*(SORT_NONE(.vector)))

        . = ORIGIN(rom_header) + 512;
        __multi_bins__ = ABSOLUTE(.);
        LONG(0x464C4553) LONG(0x00000000) /*SELF*/      LONG(LENGTH(fw_header)) LONG(__rom_end__ - __rom_start__ + LENGTH(fw_header) + LENGTH(rom_header))
        LONG(0x0000504E) LONG(0x00000000) /*NP*/        LONG(0x00000000) LONG(0x00000000)
        LONG(0x0000504C) LONG(0x00000000) /*LP*/        LONG(0x00000000) LONG(0x00000000)
        LONG(0x52415744) LONG(0x49464346) /*DWARFCFI*/  LONG(0x00000000) LONG(0x00000000)
        LONG(0x464D4F52) LONG(0x00000053) /*ROMFS*/     LONG(0x00000000) LONG(0x00000000)
        LONG(0x54524543) LONG(0x00000053) /*CERTS*/     LONG(0x00000000) LONG(0x00000000)
        LONG(0x4F545541) LONG(0x5453494C) /*AUTOLIST*/  LONG(0x00000000) LONG(0x00000000)
        LONG(0xFFFFFFFF) LONG(0xFFFFFFFF)               LONG(0xFFFFFFFF) LONG(0xFFFFFFFF)
    } > rom_header

    .rftlv.tool ORIGIN(rom_header) + 1K:
    {
        PROVIDE( _ld_symbol_rftlv_address = . );
        LONG(0x46524C42);
        LONG(0x41524150);
        . = ORIGIN(rom_header) + 1K + 2K;
    } > rom_header

    .ver ORIGIN(rom_header) + 3K:
    {
        LONG(0x42464c42); /* BLFB */
        LONG(0x46524556); /* VERF */
        KEEP (*(.bflb_verinf))
        LONG(0x42464c42); /* BLFB */
        LONG(0x46524556); /* VERF */
        KEEP (*(.verinfo))
        . = ALIGN(4);
        _version_info_section_start = .;
        KEEP(*(.version.*))
        _version_info_section_end = .;
    } > rom_header

    .init_code :
    {
        *system_bl616*.o*(.rodata*)
        *system_bl616*.o*(.srodata*)
        *system_bl616*.o*(.text*)

        *start_load*.o*(.rodata*)
        *start_load*.o*(.srodata*)
        *start_load*.o*(.text*)

        *remain_wifi_ramrv_pmp*.o*(.rodata*)
        *rv_pmp*.o*(.srodata*)
        *rv_pmp*.o*(.text*)

        *rv_Sv39*.o*(.rodata*)
        *rv_Sv39*.o*(.srodata*)
        *rv_Sv39*.o*(.text*)
    } > rom_header
    GROUP_END(rom_header)

    GROUP_START(ram_nocache)
    SECTION_DATA_PROLOGUE(ram_nocache_data, ,)
    {
        . = ALIGN(4);

        *(.nocache_ram)

        . = ALIGN(4);
    } > ram_nocache AT > rom

    SECTION_BSS_PROLOGUE(ram_nocache_noinit, (NOLOAD),)
    {
        . = ALIGN(4);
        *(.nocache_noinit_ram)
        *(.noncacheable)

        . = ALIGN(4);
    } > ram_nocache
    GROUP_END(ram_nocache)

    /* Skip the nocache region */
    .ram_skip_nocache_region (NOLOAD) :
    {
        . += (ABSOLUTE(__ram_nocache_end__) - ABSOLUTE(ORIGIN(ram_nocache)));
        . = ALIGN(32);
    } > ram

    GROUP_START(ram)
    SECTION_DATA_PROLOGUE(itcm, ,)
    {
        . = ALIGN(4);

        *(.tcm_code.*)
        *(.tcm_const.*)
        *(.sclock_rlt_code.*)
        *(.sclock_rlt_const.*)

        *bl616_glb*.o*(.rodata*)
        *bl616_pds*.o*(.rodata*)
        *bl616_common*.o*(.rodata*)
        *bflb_sf_cfg*.o*(.rodata*)
        *bflb_sf_ctrl*.o*(.rodata*)
        *bflb_sflash*.o*(.rodata*)
        *bflb_xip_sflash*.o*(.rodata*)
        *bflb_ef_ctrl*.o*(.rodata*)
        *bl616_ef_cfg*.o*(.rodata*)
        *bl616_clock*.o*(.rodata*)
        *_clz*.o*(.rodata*)
        *bflb_flash*.o*(.rodata*)
        *bl616_romapi_patch*.o*(.rodata*)

        *_udivdi3*.o*(.text*)

        /* ZigBee/Thread specific: Keep critical data in TCM for performance */
        *ZigBeeCluster*.o*(.rodata*)
        *ZigBeeCluster*.o*(.srodata*)
        *ZigBeeDefaults.o*(.srodata*)
        *IEEE802154Defaults.o*(.srodata*)
        *stack_main*.o*(.rodata*)
        *stack_main*.o*(.srodata*)

        PROVIDE( __global_pointer$ = . + 0x800 );

        . = ALIGN(4);
    } > ram AT > rom

    SECTION_DATA_PROLOGUE(dtcm, ,)
    {
        . = ALIGN(4);

        *(.tcm_data)

        . = ALIGN(4);
    } > ram AT > rom

    SECTION_DATA_PROLOGUE(ram_data, ,)
    {
        . = ALIGN(4);

        *(.data)
        *(.data.*)
        *(.sdata)
        *(.sdata.*)
        *(.sdata2)
        *(.sdata2.*)

        . = ALIGN(8);
        *(._k_queue.static.*)
        *(._k_sem.static.*)
        *(._k_mutex.static.*)
        _bt_gatt_service_static_list_start = .;
        KEEP(*(SORT_BY_NAME("._bt_gatt_service_static.static.*")))
        _bt_gatt_service_static_list_end = .;
        _bt_l2cap_fixed_chan_list_start = .;
        KEEP(*(SORT_BY_NAME("._bt_l2cap_fixed_chan.static.*")))
        _bt_l2cap_fixed_chan_list_end = .;
        _bt_l2cap_br_fixed_chan_list_start = .;
        KEEP(*(SORT_BY_NAME("._bt_l2cap_br_fixed_chan.static.*")))
        _bt_l2cap_br_fixed_chan_list_end = .;

        . = ALIGN(4);
        __bflb_log_tags_start__ = .;
        *(.bflb_log_tags_array)
        . = ALIGN(4);
        __bflb_log_tags_end__ = .;
    } > ram AT > rom

    SECTION_BSS_PROLOGUE(ram_bss, (NOLOAD),)
    {
        . = ALIGN(16);
        . = . + 0x1000;
        __StackTop = .;
        __freertos_irq_stack_top = .;

        . = ALIGN(16);
        /* for CPU_NP */
        . = . + 0x1000;
        __StackTop_NP = .;

        . = ALIGN(16);
        . = . + 0x1000;
        __freertos_high_irq_stack_top = .;

        *(.bss*)
        *(.sbss*)
        *(COMMON)

        . = ALIGN(4);
    } > ram

    SECTION_BSS_PROLOGUE(ram_noinit, (NOLOAD),)
    {
        . = ALIGN(4);
        *(.noinit_data*)
        KEEP(*(.heap*))
        . = ALIGN(4);
    } > ram

    __HeapBase = ABSOLUTE(.);
    __HeapLimit = ABSOLUTE(ORIGIN(ram) + LENGTH(ram));
    GROUP_END(ram)


    GROUP_START(ram_psram)
    SECTION_DATA_PROLOGUE(psram_data, ,)
    {
        . = ALIGN(32);

        KEEP(*(.psram_code*))

        . = ALIGN(32);

        KEEP(*(.psram_data*))

        . = ALIGN(32);
    } > ram_psram AT > rom

    SECTION_BSS_PROLOGUE(psram_noinit_data, (NOLOAD),)
    {
        . = ALIGN(4);
        KEEP(*(.psram_noinit*))
        KEEP(*(.img_buf*))

        . = ALIGN(32);
        KEEP(*(.psram_heap*))

        . = ALIGN(4);
    } > ram_psram
    __psram_heap_base = ABSOLUTE(ALIGN(., 32));
    __psram_limit = ABSOLUTE(ORIGIN(ram_psram) + LENGTH(ram_psram));
    GROUP_END(ram_psram)

    GROUP_START(ram_wifi)
#ifdef CONFIG_LPAPP
    SECTION_BSS_PROLOGUE(lpfw_share, (NOLOAD),)
    {
        _sshram = . ;
        *(.lpfw_share_nocache_noinit*)
        __lpfw_share_used__ = .;
        . = (__lpfw_share_used__ < _sshram + __LPFW_SIZE ) ? _sshram + __LPFW_SIZE : .;
    } > ram_wifi
#endif

    SECTION_BSS_PROLOGUE(wifi_bss, (NOLOAD),)
    {
#ifndef CONFIG_LPAPP
        _sshram = . ;
#endif
        *(SHAREDRAMIPC)
        *(SHAREDRAM)
        *(.wifi_ram*)
        _eshram = . ;
        . = ALIGN(16);
    } > ram_wifi

    PROVIDE( _heap_wifi_start = . );
    PROVIDE( _heap_wifi_size = ORIGIN(ram_wifi) + LENGTH(ram_wifi) - _heap_wifi_start );
    GROUP_END(ram_wifi)

    GROUP_START(hbn_memory)
    SECTION_DATA_PROLOGUE(hbn_ram, ,)
    {
        . = ALIGN(32);
        KEEP(*(.hbn_code.*))
        KEEP(*(.hbn_data.*))
        . = ALIGN(32);
    } > hbn_memory  AT > rom
    GROUP_START(hbn_memory)

    GROUP_START(rom)
    SECTION_BSS_PROLOGUE(rom_code, ,)
    {
        . = ALIGN(4); __mem_sections = ABSOLUTE(.);
        LONG(__ram_nocache_start__); LONG(__ram_nocache_end__); LONG(__ram_nocache_end__);
        . = ALIGN(4); __ram_section = ABSOLUTE(.);
        LONG(__ram_start__);         LONG(__ram_end__);         LONG(ORIGIN(ram)+LENGTH(ram));
        . = ALIGN(4); __psram_section = ABSOLUTE(.);
        LONG(__ram_psram_start__);   LONG(__ram_psram_end__);   LONG(ORIGIN(ram_psram)+LENGTH(ram_psram));
        . = ALIGN(4); __ram_wifi_section = ABSOLUTE(.);
        LONG(__ram_wifi_start__);    LONG(__ram_wifi_end__);    LONG(ORIGIN(ram_wifi)+LENGTH(ram_wifi));
        LONG(0xffffffff);            LONG(0xffffffff);          LONG(0xffffffff);

        . = ALIGN(4); __mem_copy_sections = ABSOLUTE(.);
        LONG(__ram_nocache_data_start__);   LONG(__ram_nocache_data_end__);   LONG(__ram_nocache_data_load__);
        LONG(__itcm_start__);               LONG(__itcm_end__);               LONG(__itcm_load__);
        LONG(__dtcm_start__);               LONG(__dtcm_end__);               LONG(__dtcm_load__);
        LONG(__ram_data_start__);           LONG(__ram_data_end__);           LONG(__ram_data_load__);
        LONG(__psram_data_start__);         LONG(__psram_data_end__);         LONG(__psram_data_load__);
        LONG(0xffffffff);                   LONG(0xffffffff);                 LONG(0xffffffff);

        . = ALIGN(4); __mem_setz_sections = ABSOLUTE(.);
        LONG(__ram_bss_start__);            LONG(__ram_bss_end__);
        LONG(__wifi_bss_start__);           LONG(__wifi_bss_end__);
        LONG(0xffffffff);                   LONG(0xffffffff);

        . = ALIGN(4); __mem_noinit_sections = ABSOLUTE(.);
        LONG(__ram_nocache_noinit_start__); LONG(__ram_nocache_noinit_end__);
        LONG(__ram_noinit_start__);         LONG(__ram_noinit_end__);
        LONG(__psram_noinit_data_start__);  LONG(__psram_noinit_data_end__);
        LONG(0xffffffff);                   LONG(0xffffffff);

        . = ALIGN(4); _dump_sections = ABSOLUTE(.);
        LONG(ORIGIN(ram_nocache));          LONG(__ram_nocache_end__ - ORIGIN(ram_nocache));
        LONG(ORIGIN(ram) + (__ram_nocache_end__ - ORIGIN(ram_nocache)));
        LONG(LENGTH(ram) - (__ram_nocache_end__ - ORIGIN(ram_nocache)));
        LONG(ORIGIN(ram_wifi));             LONG(LENGTH(ram_wifi));
        LONG(ORIGIN(ram_psram));            LONG(LENGTH(ram_psram));
        LONG(0xffffffff);                   LONG(0xffffffff);

        *(.text*)
        *(.rodata*)

        /* ZigBee/Thread specific: Network preprocess section */
        . = ALIGN(4);
        __start_nwk_preprocess = .;
        KEEP(*(nwk_preprocess))
        __stop_nwk_preprocess = .;
        . = ALIGN(4);
        __start_c7b_datastubd = .;
        KEEP(*(c7b_datastubd))
        __stop_c7b_datastubd = .;
        . = ALIGN(4);
        __start_c7b_gd = .;
        KEEP(*(c7b_gd))
        __stop_c7b_gd = .;
        . = ALIGN(4);
        __start_c7b_kasuites = .;
        KEEP(*(c7b_kasuites))
        __stop_c7b_kasuites = .;
        . = ALIGN(4);
        __start_c7b_kapsks = .;
        KEEP(*(c7b_kapsks))
        __stop_c7b_kapsks = .;
        . = ALIGN(4);
        __start_c7bex_gwa = .;
        KEEP(*(c7bex_gwa))
        __stop_c7bex_gwa = .;
        . = ALIGN(4);
        __start_c7bfx_iaszd = .;
        KEEP(*(c7bfx_iaszd))
        __stop_c7bfx_iaszd = .;
        . = ALIGN(4);
        __start_c7bfx_timecd = .;
        KEEP(*(c7bfx_timecd))
        __stop_c7bfx_timecd = .;
        . = ALIGN(4);
        __start_c7bfx_tld = .;
        KEEP(*(c7bfx_tld))
        __stop_c7bfx_tld = .;

        /* section information for shell */
        . = ALIGN(4);
        __fsymtab_start = .;
        KEEP(*(FSymTab))
        __fsymtab_end = .;

        . = ALIGN(4);
        __vsymtab_start = .;
        KEEP(*(VSymTab))
        __vsymtab_end = .;

        /* section information for usb usbh_class_info */
        . = ALIGN(4);
        __usbh_class_info_start__ = .;
        KEEP(*(.usbh_class_info))
        . = ALIGN(4);
        __usbh_class_info_end__ = .;

        /* section information for sysinit */
        . = ALIGN(4);
        __sysinit_array_start = .;
        KEEP(*(SORT_BY_NAME(.sysinit.*)))
        __sysinit_array_stop = .;

        *(.srodata*)

        /* global object for c++ */
        . = ALIGN(4);
        __preinit_array_start = .;
        KEEP (*(.preinit_array))
        __preinit_array_end = .;

        . = ALIGN(4);
        __init_array_start = .;
        KEEP (*(SORT_BY_INIT_PRIORITY(.init_array.*)))
        KEEP (*(.init_array))
        __init_array_end = .;

        . = ALIGN(4);
        *(.gcc_except_table.*)

    } > rom

#ifdef CONFIG_LPAPP
    SECTION_DATA_PROLOGUE(lpfw, ,)
    {
        /* For DMA Burst copy lpfw binary from flash to ram */
        . = ALIGN(32);
        LONG(0x0);        /* LPFW SHA256 */
        . = ALIGN(32);
        LONG(0x5746504C); /* LPFW */
        . = ALIGN(32);

        __lpfw_load_addr = .;
    } > rom
#endif
    GROUP_END(rom)
}
